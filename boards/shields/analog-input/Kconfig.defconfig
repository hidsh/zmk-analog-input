## boards/shields/analog-input/Kconfig.defconfig
```kconfig
if SHIELD_ANALOG_INPUT

    config ZMK_KEYBOARD_NAME
        default "ANALOG-INPUT"

    config ZMK_BLE
        bool
        default y

endif
```

## boards/shields/analog-input/Kconfig.shield
```kconfig
# No whitespace after the comma or in your keyboard name!
config SHIELD_ANALOG_INPUT
    def_bool $(shields_list_contains,analog_input)
```
